/{

    /*
     * NOTE:
     *  このスニペットで定義される listener も、
     *  config/keymap.keymap で `&trackball_listener` が再定義されている場合は
     *  そちらに上書きされます。
     *  トラックボールの向き・スクロールのカスタムは
     *  keymap.keymap 側で管理する前提です。
     */

    split_inputs {
        #address-cells = <1>;
        #size-cells = <0>;

        trackball_split: trackball_split@0 {
            compatible = "zmk,input-split";
            reg = <0>;
        };
    };

    trackball_split_listener: trackball_split_listener {
        compatible = "zmk,input-listener";
        device = <&trackball_split>;
        status = "okay";
        input-processors = <&zip_xy_transform (INPUT_TRANSFORM_X_INVERT | INPUT_TRANSFORM_Y_INVERT)>;
    };
};
